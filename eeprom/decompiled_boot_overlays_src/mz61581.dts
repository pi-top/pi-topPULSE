/dts-v1/;

/ {
	compatible = "brcm,bcm2835", "brcm,bcm2708", "brcm,bcm2709";

	fragment@0 {
		target = <0xdeadbeef>;

		__overlay__ {
			status = "okay";
		};
	};

	fragment@1 {
		target = <0xdeadbeef>;

		__overlay__ {
			status = "disabled";
		};
	};

	fragment@2 {
		target = <0xdeadbeef>;

		__overlay__ {
			status = "disabled";
		};
	};

	fragment@3 {
		target = <0xdeadbeef>;

		__overlay__ {

			mz61581_pins {
				brcm,pins = <0x4 0xf 0x12 0x19>;
				brcm,function = <0x0 0x1 0x1 0x1>;
				phandle = <0x1>;
			};
		};
	};

	fragment@4 {
		target = <0xdeadbeef>;

		__overlay__ {
			#address-cells = <0x1>;
			#size-cells = <0x0>;

			mz61581@0 {
				compatible = "samsung,s6d02a1";
				reg = <0x0>;
				pinctrl-names = "default";
				pinctrl-0 = <0x1>;
				spi-max-frequency = <0x7a12000>;
				spi-cpol;
				spi-cpha;
				width = <0x140>;
				height = <0x1e0>;
				rotate = <0x10e>;
				bgr;
				fps = <0x1e>;
				buswidth = <0x8>;
				txbuflen = <0x8000>;
				reset-gpios = <0xdeadbeef 0xf 0x0>;
				dc-gpios = <0xdeadbeef 0x19 0x0>;
				led-gpios = <0xdeadbeef 0x12 0x0>;
				init = <0x10000b0 0x0 0x1000011 0x20000ff 0x10000b3 0x2 0x0 0x0 0x0 0x10000c0 0x13 0x3b 0x0 0x2 0x0 0x1 0x0 0x43 0x10000c1 0x8 0x16 0x8 0x8 0x10000c4 0x11 0x7 0x3 0x3 0x10000c6 0x0 0x10000c8 0x3 0x3 0x13 0x5c 0x3 0x7 0x14 0x8 0x0 0x21 0x8 0x14 0x7 0x53 0xc 0x13 0x3 0x3 0x21 0x0 0x1000035 0x0 0x1000036 0xa0 0x100003a 0x55 0x1000044 0x0 0x1 0x10000d0 0x7 0x7 0x1d 0x3 0x10000d1 0x3 0x30 0x10 0x10000d2 0x3 0x14 0x4 0x1000029 0x100002c>;
				debug = <0x3>;
				phandle = <0x2>;
			};

			mz61581_ts@1 {
				compatible = "ti,ads7846";
				reg = <0x1>;
				spi-max-frequency = <0x1e8480>;
				interrupts = <0x4 0x2>;
				interrupt-parent = <0xdeadbeef>;
				pendown-gpio = <0xdeadbeef 0x4 0x0>;
				ti,x-plate-ohms = [00 3c];
				ti,pressure-max = [00 ff];
				phandle = <0x3>;
			};
		};
	};

	__overrides__ {
		speed = <0x2 0x7370692d 0x6d61782d 0x66726571 0x75656e63 0x793a3000>;
		rotate = [00 00 00 02 72 6f 74 61 74 65 3a 30 00];
		fps = [00 00 00 02 66 70 73 3a 30 00];
		txbuflen = [00 00 00 02 74 78 62 75 66 6c 65 6e 3a 30 00];
		debug = <0x2 0x64656275 0x673a3000>;
		xohms = [00 00 00 03 74 69 2c 78 2d 70 6c 61 74 65 2d 6f 68 6d 73 3b 30 00];
	};

	__symbols__ {
		mz61581_pins = "/fragment@3/__overlay__/mz61581_pins";
		mz61581 = "/fragment@4/__overlay__/mz61581@0";
		mz61581_ts = "/fragment@4/__overlay__/mz61581_ts@1";
	};

	__local_fixups__ {

		fragment@4 {

			__overlay__ {

				mz61581@0 {
					pinctrl-0 = <0x0>;
				};
			};
		};

		__overrides__ {
			speed = <0x0>;
			rotate = <0x0>;
			fps = <0x0>;
			txbuflen = <0x0>;
			debug = <0x0>;
			xohms = <0x0>;
		};
	};

	__fixups__ {
		spi0 = "/fragment@0:target:0", "/fragment@4:target:0";
		spidev0 = "/fragment@1:target:0";
		spidev1 = "/fragment@2:target:0";
		gpio = "/fragment@3:target:0", "/fragment@4/__overlay__/mz61581@0:reset-gpios:0", "/fragment@4/__overlay__/mz61581@0:dc-gpios:0", "/fragment@4/__overlay__/mz61581@0:led-gpios:0", "/fragment@4/__overlay__/mz61581_ts@1:interrupt-parent:0", "/fragment@4/__overlay__/mz61581_ts@1:pendown-gpio:0";
	};
};
