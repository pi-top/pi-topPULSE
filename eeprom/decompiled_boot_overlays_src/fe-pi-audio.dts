/dts-v1/;

/ {
	compatible = "brcm,bcm2708";

	fragment@0 {
		target = <0xdeadbeef>;

		__overlay__ {

			sgtl5000_mclk {
				compatible = "fixed-clock";
				#clock-cells = <0x0>;
				clock-frequency = <0xbb8000>;
				clock-output-names = "sgtl5000-mclk";
				phandle = <0x1>;
			};
		};
	};

	fragment@1 {
		target = <0xdeadbeef>;

		__overlay__ {

			reg_1v8@0 {
				compatible = "regulator-fixed";
				regulator-name = "1V8";
				regulator-min-microvolt = <0x1b7740>;
				regulator-max-microvolt = <0x1b7740>;
				regulator-always-on;
				phandle = <0x2>;
			};
		};
	};

	fragment@2 {
		target = <0xdeadbeef>;

		__overlay__ {
			#address-cells = <0x1>;
			#size-cells = <0x0>;
			status = "okay";

			sgtl5000@0a {
				#sound-dai-cells = <0x0>;
				compatible = "fepi,sgtl5000";
				reg = <0xa>;
				clocks = <0x1>;
				micbias-resistor-k-ohms = <0x2>;
				micbias-voltage-m-volts = <0xbb8>;
				VDDA-supply = <0xdeadbeef>;
				VDDIO-supply = <0xdeadbeef>;
				VDDD-supply = <0x2>;
				status = "okay";
			};
		};
	};

	fragment@3 {
		target = <0xdeadbeef>;

		__overlay__ {
			status = "okay";
		};
	};

	fragment@4 {
		target = <0xdeadbeef>;

		__overlay__ {
			compatible = "fe-pi,fe-pi-audio";
			i2s-controller = <0xdeadbeef>;
			status = "okay";
		};
	};

	__symbols__ {
		sgtl5000_mclk = "/fragment@0/__overlay__/sgtl5000_mclk";
		reg_1v8 = "/fragment@1/__overlay__/reg_1v8@0";
	};

	__local_fixups__ {

		fragment@2 {

			__overlay__ {

				sgtl5000@0a {
					clocks = <0x0>;
					VDDD-supply = <0x0>;
				};
			};
		};
	};

	__fixups__ {
		clocks = "/fragment@0:target:0";
		soc = "/fragment@1:target:0";
		i2c1 = "/fragment@2:target:0";
		vdd_3v3_reg = "/fragment@2/__overlay__/sgtl5000@0a:VDDA-supply:0", "/fragment@2/__overlay__/sgtl5000@0a:VDDIO-supply:0";
		i2s = "/fragment@3:target:0", "/fragment@4/__overlay__:i2s-controller:0";
		sound = "/fragment@4:target:0";
	};
};
