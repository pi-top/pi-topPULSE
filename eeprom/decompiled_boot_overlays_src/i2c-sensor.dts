/dts-v1/;

/ {
	compatible = "brcm,bcm2708";

	fragment@0 {
		target = <0xdeadbeef>;

		__overlay__ {
			#address-cells = <0x1>;
			#size-cells = <0x0>;
			status = "okay";

			bme280@76 {
				compatible = "bosch,bme280";
				reg = <0x76>;
				status = "disable";
				phandle = <0x1>;
			};

			bmp085@77 {
				compatible = "bosch,bmp085";
				reg = <0x77>;
				default-oversampling = <0x3>;
				status = "disable";
				phandle = <0x4>;
			};

			bmp180@77 {
				compatible = "bosch,bmp180";
				reg = <0x77>;
				status = "disable";
				phandle = <0x5>;
			};

			bmp280@76 {
				compatible = "bosch,bmp280";
				reg = <0x76>;
				status = "disable";
				phandle = <0x2>;
			};

			lm75@4f {
				compatible = "lm75";
				reg = <0x4f>;
				status = "disable";
				phandle = <0x6>;
			};

			si7020@40 {
				compatible = "si7020";
				reg = <0x40>;
				status = "disable";
				phandle = <0x7>;
			};

			tmp102@48 {
				compatible = "ti,tmp102";
				reg = <0x48>;
				status = "disable";
				phandle = <0x3>;
			};
		};
	};

	__overrides__ {
		addr = [00 00 00 01 72 65 67 3a 30 00 00 00 00 02 72 65 67 3a 30 00 00 00 00 03 72 65 67 3a 30 00];
		bme280 = [00 00 00 01 73 74 61 74 75 73 00];
		bmp085 = [00 00 00 04 73 74 61 74 75 73 00];
		bmp180 = [00 00 00 05 73 74 61 74 75 73 00];
		bmp280 = [00 00 00 02 73 74 61 74 75 73 00];
		lm75 = [00 00 00 06 73 74 61 74 75 73 00];
		lm75addr = [00 00 00 06 72 65 67 3a 30 00];
		si7020 = "", "", "", "\astatus";
		tmp102 = [00 00 00 03 73 74 61 74 75 73 00];
	};

	__symbols__ {
		bme280 = "/fragment@0/__overlay__/bme280@76";
		bmp085 = "/fragment@0/__overlay__/bmp085@77";
		bmp180 = "/fragment@0/__overlay__/bmp180@77";
		bmp280 = "/fragment@0/__overlay__/bmp280@76";
		lm75 = "/fragment@0/__overlay__/lm75@4f";
		si7020 = "/fragment@0/__overlay__/si7020@40";
		tmp102 = "/fragment@0/__overlay__/tmp102@48";
	};

	__local_fixups__ {

		__overrides__ {
			addr = <0x0 0xa 0x14>;
			bme280 = <0x0>;
			bmp085 = <0x0>;
			bmp180 = <0x0>;
			bmp280 = <0x0>;
			lm75 = <0x0>;
			lm75addr = <0x0>;
			si7020 = <0x0>;
			tmp102 = <0x0>;
		};
	};

	__fixups__ {
		i2c_arm = "/fragment@0:target:0";
	};
};
