/dts-v1/;

/ {
	compatible = "brcm,bcm2835", "brcm,bcm2708", "brcm,bcm2709";

	fragment@0 {
		target = <0xdeadbeef>;

		__overlay__ {
			status = "okay";
		};
	};

	fragment@1 {
		target = <0xdeadbeef>;

		__overlay__ {
			status = "disabled";
		};
	};

	fragment@2 {
		target = <0xdeadbeef>;

		__overlay__ {

			pitft_pins {
				brcm,pins = <0x18 0x19>;
				brcm,function = <0x0 0x1>;
				brcm,pull = <0x2 0x0>;
				phandle = <0x1>;
			};
		};
	};

	fragment@3 {
		target = <0xdeadbeef>;

		__overlay__ {
			#address-cells = <0x1>;
			#size-cells = <0x0>;

			pitft@0 {
				compatible = "ilitek,ili9340";
				reg = <0x0>;
				pinctrl-names = "default";
				pinctrl-0 = <0x1>;
				spi-max-frequency = <0x1e84800>;
				rotate = <0x5a>;
				fps = <0x19>;
				bgr;
				buswidth = <0x8>;
				dc-gpios = <0xdeadbeef 0x19 0x0>;
				debug = <0x0>;
				phandle = <0x2>;
			};
		};
	};

	fragment@4 {
		target = <0xdeadbeef>;

		__overlay__ {
			#address-cells = <0x1>;
			#size-cells = <0x0>;

			ft6236@38 {
				compatible = "focaltech,ft6236";
				reg = <0x38>;
				interrupt-parent = <0xdeadbeef>;
				interrupts = <0x18 0x2>;
				touchscreen-size-x = <0xf0>;
				touchscreen-size-y = <0x140>;
				phandle = <0x3>;
			};
		};
	};

	__overrides__ {
		speed = <0x2 0x7370692d 0x6d61782d 0x66726571 0x75656e63 0x793a3000>;
		rotate = [00 00 00 02 72 6f 74 61 74 65 3a 30 00];
		fps = [00 00 00 02 66 70 73 3a 30 00];
		debug = <0x2 0x64656275 0x673a3000>;
		touch-sizex = <0x3 0x746f7563 0x68736372 0x65656e2d 0x73697a65 0x2d783f00>;
		touch-sizey = <0x3 0x746f7563 0x68736372 0x65656e2d 0x73697a65 0x2d793f00>;
		touch-invx = <0x3 0x746f7563 0x68736372 0x65656e2d 0x696e7665 0x72746564 0x2d783f00>;
		touch-invy = <0x3 0x746f7563 0x68736372 0x65656e2d 0x696e7665 0x72746564 0x2d793f00>;
		touch-swapxy = [00 00 00 03 74 6f 75 63 68 73 63 72 65 65 6e 2d 73 77 61 70 70 65 64 2d 78 2d 79 3f 00];
	};

	__symbols__ {
		pitft_pins = "/fragment@2/__overlay__/pitft_pins";
		pitft = "/fragment@3/__overlay__/pitft@0";
		ft6236 = "/fragment@4/__overlay__/ft6236@38";
	};

	__local_fixups__ {

		fragment@3 {

			__overlay__ {

				pitft@0 {
					pinctrl-0 = <0x0>;
				};
			};
		};

		__overrides__ {
			speed = <0x0>;
			rotate = <0x0>;
			fps = <0x0>;
			debug = <0x0>;
			touch-sizex = <0x0>;
			touch-sizey = <0x0>;
			touch-invx = <0x0>;
			touch-invy = <0x0>;
			touch-swapxy = <0x0>;
		};
	};

	__fixups__ {
		spi0 = "/fragment@0:target:0", "/fragment@3:target:0";
		spidev0 = "/fragment@1:target:0";
		gpio = "/fragment@2:target:0", "/fragment@3/__overlay__/pitft@0:dc-gpios:0", "/fragment@4/__overlay__/ft6236@38:interrupt-parent:0";
		i2c1 = "/fragment@4:target:0";
	};
};
