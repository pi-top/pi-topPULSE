/dts-v1/;

/ {
	compatible = "brcm,bcm2708";

	fragment@0 {
		target = <0xdeadbeef>;

		__overlay__ {
			status = "okay";
		};
	};

	fragment@1 {
		target-path = [2f 00];

		__overlay__ {

			pcm1794a-codec {
				#sound-dai-cells = <0x0>;
				compatible = "ti,pcm1794a";
				status = "okay";
			};
		};
	};

	fragment@2 {
		target = <0xdeadbeef>;

		__overlay__ {
			compatible = "rpi,rpi-dac";
			i2s-controller = <0xdeadbeef>;
			status = "okay";
		};
	};

	__fixups__ {
		i2s = "/fragment@0:target:0", "/fragment@2/__overlay__:i2s-controller:0";
		sound = "/fragment@2:target:0";
	};
};
