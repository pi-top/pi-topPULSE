/dts-v1/;

/ {
	compatible = "brcm,bcm2708";

	fragment@0 {
		target-path = [2f 00];

		__overlay__ {

			rpi_ft5406 {
				compatible = "rpi,rpi-ft5406";
				firmware = <0xdeadbeef>;
				status = "okay";
				phandle = <0x1>;
			};
		};
	};

	__symbols__ {
		rpi_ft5406 = "/fragment@0/__overlay__/rpi_ft5406";
	};

	__fixups__ {
		firmware = "/fragment@0/__overlay__/rpi_ft5406:firmware:0";
	};
};
