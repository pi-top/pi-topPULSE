/dts-v1/;

/ {
	compatible = "brcm,bcm2835", "brcm,bcm2836", "brcm,bcm2708", "brcm,bcm2709";

	fragment@0 {
		target = <0xdeadbeef>;

		__overlay__ {
			cs-gpios = <0xdeadbeef 0x24 0x1 0xdeadbeef 0x23 0x1>;
		};
	};

	fragment@1 {
		target = <0xdeadbeef>;

		__overlay__ {
			brcm,pins = <0x24 0x23>;
		};
	};

	fragment@2 {
		target = <0xdeadbeef>;

		__overlay__ {
			brcm,pins = <0x25 0x26 0x27>;
		};
	};

	__fixups__ {
		spi0 = "/fragment@0:target:0";
		gpio = "/fragment@0/__overlay__:cs-gpios:0", "/fragment@0/__overlay__:cs-gpios:12";
		spi0_cs_pins = "/fragment@1:target:0";
		spi0_pins = "/fragment@2:target:0";
	};
};
