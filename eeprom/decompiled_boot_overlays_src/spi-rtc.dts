/dts-v1/;

/ {
	compatible = "brcm,bcm2708";

	fragment@0 {
		target = <0xdeadbeef>;

		__dormant__ {
			status = "disabled";
		};
	};

	fragment@1 {
		target = <0xdeadbeef>;

		__dormant__ {
			#address-cells = <0x1>;
			#size-cells = <0x0>;
			status = "okay";

			rtc-pcf2123@0 {
				compatible = "nxp,rtc-pcf2123";
				spi-max-frequency = <0x4c4b40>;
				spi-cs-high = <0x1>;
				reg = <0x0>;
			};
		};
	};

	__overrides__ {
		pcf2123 = [00 00 00 00 3d 30 3d 31 00];
	};

	__fixups__ {
		spidev0 = "/fragment@0:target:0";
		spi0 = "/fragment@1:target:0";
	};
};
