/dts-v1/;

/ {
	compatible = "brcm,bcm2708";

	fragment@0 {
		target = <0xdeadbeef>;

		__overlay__ {
			status = "okay";
		};
	};

	fragment@1 {
		target = <0xdeadbeef>;

		__overlay__ {
			#address-cells = <0x1>;
			#size-cells = <0x0>;
			status = "okay";

			pcm5122@4d {
				#sound-dai-cells = <0x0>;
				compatible = "ti,pcm5122";
				reg = <0x4d>;
				AVDD-supply = <0xdeadbeef>;
				DVDD-supply = <0xdeadbeef>;
				CPVDD-supply = <0xdeadbeef>;
				status = "okay";
			};
		};
	};

	fragment@2 {
		target = <0xdeadbeef>;

		__overlay__ {
			compatible = "justboom,justboom-dac";
			i2s-controller = <0xdeadbeef>;
			status = "okay";
			phandle = <0x1>;
		};
	};

	__overrides__ {
		24db_digital_gain = <0x1 0x6a757374 0x626f6f6d 0x2c323464 0x625f6469 0x67697461 0x6c5f6761 0x696e3f00>;
	};

	__symbols__ {
		frag2 = "/fragment@2/__overlay__";
	};

	__local_fixups__ {

		__overrides__ {
			24db_digital_gain = <0x0>;
		};
	};

	__fixups__ {
		i2s = "/fragment@0:target:0", "/fragment@2/__overlay__:i2s-controller:0";
		i2c1 = "/fragment@1:target:0";
		vdd_3v3_reg = "/fragment@1/__overlay__/pcm5122@4d:AVDD-supply:0", "/fragment@1/__overlay__/pcm5122@4d:DVDD-supply:0", "/fragment@1/__overlay__/pcm5122@4d:CPVDD-supply:0";
		sound = "/fragment@2:target:0";
	};
};
