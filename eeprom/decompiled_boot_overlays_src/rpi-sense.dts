/dts-v1/;

/ {
	compatible = "brcm,bcm2708", "brcm,bcm2709";

	fragment@0 {
		target = <0xdeadbeef>;

		__overlay__ {
			#address-cells = <0x1>;
			#size-cells = <0x0>;
			status = "okay";

			rpi-sense@46 {
				compatible = "rpi,rpi-sense";
				reg = <0x46>;
				keys-int-gpios = <0xdeadbeef 0x17 0x1>;
				status = "okay";
			};

			lsm9ds1-magn@1c {
				compatible = "st,lsm9ds1-magn";
				reg = <0x1c>;
				status = "okay";
			};

			lsm9ds1-accel6a {
				compatible = "st,lsm9ds1-accel";
				reg = <0x6a>;
				status = "okay";
			};

			lps25h-press@5c {
				compatible = "st,lps25h-press";
				reg = <0x5c>;
				status = "okay";
			};

			hts221-humid@5f {
				compatible = "st,hts221-humid";
				reg = <0x5f>;
				status = "okay";
			};
		};
	};

	__fixups__ {
		i2c1 = "/fragment@0:target:0";
		gpio = "/fragment@0/__overlay__/rpi-sense@46:keys-int-gpios:0";
	};
};
