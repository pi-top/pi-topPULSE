/dts-v1/;

/ {
	compatible = "brcm,bcm2708";

	fragment@0 {
		target = <0xdeadbeef>;

		__overlay__ {
			status = "okay";
		};
	};

	fragment@1 {
		target = <0xdeadbeef>;

		__overlay__ {
			brcm,pins = <0x0 0x1>;
			brcm,function = <0x4>;
			phandle = <0x1>;
		};
	};

	fragment@2 {
		target = <0xdeadbeef>;

		__dormant__ {
			brcm,pins = <0x1c 0x1d>;
			brcm,function = <0x4>;
		};
	};

	fragment@3 {
		target = <0xdeadbeef>;

		__dormant__ {
			brcm,pins = <0x2c 0x2d>;
			brcm,function = <0x5>;
		};
	};

	fragment@4 {
		target = <0xdeadbeef>;

		__dormant__ {
			brcm,pins = <0x2e 0x2f>;
			brcm,function = <0x4>;
		};
	};

	__overrides__ {
		sda0_pin = <0x1 0x6272636d 0x2c70696e 0x733a3000>;
		scl0_pin = <0x1 0x6272636d 0x2c70696e 0x733a3400>;
		pins_0_1 = "", "", "", "", "+1-2-3-4";
		pins_28_29 = "", "", "", "", "-1+2-3-4";
		pins_44_45 = "", "", "", "", "-1-2+3-4";
		pins_46_47 = "", "", "", "", "-1-2-3+4";
	};

	__symbols__ {
		frag1 = "/fragment@1/__overlay__";
	};

	__local_fixups__ {

		__overrides__ {
			sda0_pin = <0x0>;
			scl0_pin = <0x0>;
		};
	};

	__fixups__ {
		i2c0 = "/fragment@0:target:0";
		i2c0_pins = "/fragment@1:target:0", "/fragment@2:target:0", "/fragment@3:target:0", "/fragment@4:target:0";
	};
};
