/dts-v1/;

/ {
	compatible = "brcm,bcm2835", "brcm,bcm2708", "brcm,bcm2709";

	fragment@0 {
		target = <0xdeadbeef>;

		__overlay__ {

			spi1_pins {
				brcm,pins = <0x13 0x14 0x15>;
				brcm,function = <0x3>;
				phandle = <0x1>;
			};

			spi1_cs_pins {
				brcm,pins = <0x12 0x11 0x10>;
				brcm,function = <0x1>;
				phandle = <0x2>;
			};
		};
	};

	fragment@1 {
		target = <0xdeadbeef>;

		__overlay__ {
			#address-cells = <0x1>;
			#size-cells = <0x0>;
			pinctrl-names = "default";
			pinctrl-0 = <0x1 0x2>;
			cs-gpios = <0xdeadbeef 0x12 0x1 0xdeadbeef 0x11 0x1 0xdeadbeef 0x10 0x1>;
			status = "okay";
			phandle = <0x3>;

			spidev@0 {
				compatible = "spidev";
				reg = <0x0>;
				#address-cells = <0x1>;
				#size-cells = <0x0>;
				spi-max-frequency = <0x7a120>;
				status = "okay";
				phandle = <0x4>;
			};

			spidev@1 {
				compatible = "spidev";
				reg = <0x1>;
				#address-cells = <0x1>;
				#size-cells = <0x0>;
				spi-max-frequency = <0x7a120>;
				status = "okay";
				phandle = <0x5>;
			};

			spidev@2 {
				compatible = "spidev";
				reg = <0x2>;
				#address-cells = <0x1>;
				#size-cells = <0x0>;
				spi-max-frequency = <0x7a120>;
				status = "okay";
				phandle = <0x6>;
			};
		};
	};

	fragment@2 {
		target = <0xdeadbeef>;

		__overlay__ {
			status = "okay";
		};
	};

	__overrides__ {
		cs0_pin = [00 00 00 02 62 72 63 6d 2c 70 69 6e 73 3a 30 00 00 00 00 03 63 73 2d 67 70 69 6f 73 3a 34 00];
		cs1_pin = <0x2 0x6272636d 0x2c70696e 0x733a3400 0x3 0x63732d67 0x70696f73 0x3a313600>;
		cs2_pin = <0x2 0x6272636d 0x2c70696e 0x733a3800 0x3 0x63732d67 0x70696f73 0x3a323800>;
		cs0_spidev = [00 00 00 04 73 74 61 74 75 73 00];
		cs1_spidev = [00 00 00 05 73 74 61 74 75 73 00];
		cs2_spidev = [00 00 00 06 73 74 61 74 75 73 00];
	};

	__symbols__ {
		spi1_pins = "/fragment@0/__overlay__/spi1_pins";
		spi1_cs_pins = "/fragment@0/__overlay__/spi1_cs_pins";
		frag1 = "/fragment@1/__overlay__";
		spidev1_0 = "/fragment@1/__overlay__/spidev@0";
		spidev1_1 = "/fragment@1/__overlay__/spidev@1";
		spidev1_2 = "/fragment@1/__overlay__/spidev@2";
	};

	__local_fixups__ {

		fragment@1 {

			__overlay__ {
				pinctrl-0 = <0x0 0x4>;
			};
		};

		__overrides__ {
			cs0_pin = <0x0 0x10>;
			cs1_pin = <0x0 0x10>;
			cs2_pin = <0x0 0x10>;
			cs0_spidev = <0x0>;
			cs1_spidev = <0x0>;
			cs2_spidev = <0x0>;
		};
	};

	__fixups__ {
		gpio = "/fragment@0:target:0", "/fragment@1/__overlay__:cs-gpios:0", "/fragment@1/__overlay__:cs-gpios:12", "/fragment@1/__overlay__:cs-gpios:24";
		spi1 = "/fragment@1:target:0";
		aux = "/fragment@2:target:0";
	};
};
