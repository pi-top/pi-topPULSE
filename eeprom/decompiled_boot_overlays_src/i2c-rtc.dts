/dts-v1/;

/ {
	compatible = "brcm,bcm2708";

	fragment@0 {
		target = <0xdeadbeef>;

		__overlay__ {
			#address-cells = <0x1>;
			#size-cells = <0x0>;
			status = "okay";

			abx80x@69 {
				compatible = "abracon,abx80x";
				reg = <0x69>;
				abracon,tc-diode = "standard";
				abracon,tc-resistor = <0x0>;
				status = "disable";
				phandle = <0x1>;
			};

			ds1307@68 {
				compatible = "maxim,ds1307";
				reg = <0x68>;
				status = "disable";
				phandle = <0x2>;
			};

			ds1339@68 {
				compatible = "dallas,ds1339";
				trickle-resistor-ohms = <0x0>;
				reg = <0x68>;
				status = "disable";
				phandle = <0x3>;
			};

			mcp7940x@6f {
				compatible = "microchip,mcp7940x";
				reg = <0x6f>;
				status = "disable";
				phandle = <0x5>;
			};

			mcp7941x@6f {
				compatible = "microchip,mcp7941x";
				reg = <0x6f>;
				status = "disable";
				phandle = <0x6>;
			};

			ds3231@68 {
				compatible = "maxim,ds3231";
				reg = <0x68>;
				status = "disable";
				phandle = <0x4>;
			};

			pcf2127@51 {
				compatible = "nxp,pcf2127";
				reg = <0x51>;
				status = "disable";
				phandle = <0x7>;
			};

			pcf8523@68 {
				compatible = "nxp,pcf8523";
				reg = <0x68>;
				status = "disable";
				phandle = <0x8>;
			};

			pcf8563@51 {
				compatible = "nxp,pcf8563";
				reg = <0x51>;
				status = "disable";
				phandle = <0x9>;
			};
		};
	};

	__overrides__ {
		abx80x = [00 00 00 01 73 74 61 74 75 73 00];
		ds1307 = [00 00 00 02 73 74 61 74 75 73 00];
		ds1339 = [00 00 00 03 73 74 61 74 75 73 00];
		ds3231 = [00 00 00 04 73 74 61 74 75 73 00];
		mcp7940x = [00 00 00 05 73 74 61 74 75 73 00];
		mcp7941x = [00 00 00 06 73 74 61 74 75 73 00];
		pcf2127 = "", "", "", "\astatus";
		pcf8523 = "", "", "", "\bstatus";
		pcf8563 = "", "", "", "\tstatus";
		trickle-diode-type = [00 00 00 01 61 62 72 61 63 6f 6e 2c 74 63 2d 64 69 6f 64 65 00];
		trickle-resistor-ohms = <0x3 0x74726963 0x6b6c652d 0x72657369 0x73746f72 0x2d6f686d 0x733a3000 0x1 0x61627261 0x636f6e2c 0x74632d72 0x65736973 0x746f7200>;
		wakeup-source = <0x3 0x77616b65 0x75702d73 0x6f757263 0x653f0000 0x477 0x616b6575 0x702d736f 0x75726365 0x3f000000 0x57761 0x6b657570 0x2d736f75 0x7263653f 0x0 0x677616b 0x6575702d 0x736f7572 0x63653f00>;
	};

	__symbols__ {
		abx80x = "/fragment@0/__overlay__/abx80x@69";
		ds1307 = "/fragment@0/__overlay__/ds1307@68";
		ds1339 = "/fragment@0/__overlay__/ds1339@68";
		mcp7940x = "/fragment@0/__overlay__/mcp7940x@6f";
		mcp7941x = "/fragment@0/__overlay__/mcp7941x@6f";
		ds3231 = "/fragment@0/__overlay__/ds3231@68";
		pcf2127 = "/fragment@0/__overlay__/pcf2127@51";
		pcf8523 = "/fragment@0/__overlay__/pcf8523@68";
		pcf8563 = "/fragment@0/__overlay__/pcf8563@51";
	};

	__local_fixups__ {

		__overrides__ {
			abx80x = <0x0>;
			ds1307 = <0x0>;
			ds1339 = <0x0>;
			ds3231 = <0x0>;
			mcp7940x = <0x0>;
			mcp7941x = <0x0>;
			pcf2127 = <0x0>;
			pcf8523 = <0x0>;
			pcf8563 = <0x0>;
			trickle-diode-type = <0x0>;
			trickle-resistor-ohms = <0x0 0x1c>;
			wakeup-source = <0x0 0x13 0x26 0x39>;
		};
	};

	__fixups__ {
		i2c_arm = "/fragment@0:target:0";
	};
};
