/dts-v1/;

/ {
	compatible = "brcm,bcm2835", "brcm,bcm2708", "brcm,bcm2709";

	fragment@0 {
		target-path = "/chosen";

		__overlay__ {
			bootargs = "cma=256M@256M";
		};
	};

	fragment@1 {
		target-path = "/chosen";

		__dormant__ {
			bootargs = "cma=192M@256M";
		};
	};

	fragment@2 {
		target-path = "/chosen";

		__dormant__ {
			bootargs = "cma=128M@128M";
		};
	};

	fragment@3 {
		target-path = "/chosen";

		__dormant__ {
			bootargs = "cma=96M@128M";
		};
	};

	fragment@4 {
		target-path = "/chosen";

		__dormant__ {
			bootargs = "cma=64M@64M";
		};
	};

	fragment@5 {
		target = <0xdeadbeef>;

		__overlay__ {
			status = "disabled";
		};
	};

	fragment@6 {
		target = <0xdeadbeef>;

		__overlay__ {
			status = "okay";
		};
	};

	fragment@7 {
		target = <0xdeadbeef>;

		__overlay__ {
			interrupts = <0x1 0xa>;
			status = "okay";
		};
	};

	fragment@8 {
		target = <0xdeadbeef>;

		__overlay__ {
			status = "okay";
		};
	};

	fragment@9 {
		target-path = "/soc/dma";

		__overlay__ {
			brcm,dma-channel-mask = <0x7f35>;
		};
	};

	__overrides__ {
		cma-256 = "", "", "", "", "+0-1-2-3-4";
		cma-192 = "", "", "", "", "-0+1-2-3-4";
		cma-128 = "", "", "", "", "-0-1+2-3-4";
		cma-96 = "", "", "", "", "-0-1-2+3-4";
		cma-64 = "", "", "", "", "-0-1-2-3+4";
	};

	__fixups__ {
		fb = "/fragment@5:target:0";
		firmwarekms = "/fragment@6:target:0";
		v3d = "/fragment@7:target:0";
		gpu = "/fragment@8:target:0";
	};
};
