/dts-v1/;

/ {
	compatible = "brcm,bcm2708";

	fragment@0 {
		target = <0xdeadbeef>;

		__overlay__ {
			#address-cells = <0x1>;
			#size-cells = <0x0>;
			status = "okay";

			spidev@0 {
				status = "disabled";
			};

			qca7000@0 {
				compatible = "qca,qca7000";
				reg = <0x0>;
				pinctrl-names = "default";
				pinctrl-0 = <0x1>;
				interrupt-parent = <0xdeadbeef>;
				interrupts = <0x17 0x1>;
				spi-max-frequency = <0xb71b00>;
				status = "okay";
				phandle = <0x2>;
			};
		};
	};

	fragment@1 {
		target = <0xdeadbeef>;

		__overlay__ {

			eth1_pins {
				brcm,pins = <0x17>;
				brcm,function = <0x0>;
				brcm,pull = <0x0>;
				phandle = <0x1>;
			};
		};
	};

	__overrides__ {
		int_pin = [00 00 00 02 69 6e 74 65 72 72 75 70 74 73 3a 30 00 00 00 00 01 62 72 63 6d 2c 70 69 6e 73 3a 30 00];
		speed = <0x2 0x7370692d 0x6d61782d 0x66726571 0x75656e63 0x793a3000>;
	};

	__symbols__ {
		eth1 = "/fragment@0/__overlay__/qca7000@0";
		eth1_pins = "/fragment@1/__overlay__/eth1_pins";
	};

	__local_fixups__ {

		fragment@0 {

			__overlay__ {

				qca7000@0 {
					pinctrl-0 = <0x0>;
				};
			};
		};

		__overrides__ {
			int_pin = <0x0 0x11>;
			speed = <0x0>;
		};
	};

	__fixups__ {
		spi0 = "/fragment@0:target:0";
		gpio = "/fragment@0/__overlay__/qca7000@0:interrupt-parent:0", "/fragment@1:target:0";
	};
};
