/dts-v1/;

/ {
	compatible = "brcm,bcm2708";

	fragment@0 {
		target = <0xdeadbeef>;

		__overlay__ {
			pinctrl-names = "default";
			pinctrl-0 = <0x1>;
			bus-width = <0x4>;
			brcm,overclock-50 = <0x0>;
			status = "okay";
			phandle = <0x2>;
		};
	};

	fragment@1 {
		target = <0xdeadbeef>;

		__overlay__ {

			mmc_pins {
				brcm,pins = <0x30 0x31 0x32 0x33 0x34 0x35>;
				brcm,function = <0x7>;
				phandle = <0x1>;
			};
		};
	};

	fragment@2 {
		target = <0xdeadbeef>;

		__overlay__ {
			status = "disabled";
		};
	};

	__overrides__ {
		overclock_50 = <0x2 0x6272636d 0x2c6f7665 0x72636c6f 0x636b2d35 0x303a3000>;
	};

	__symbols__ {
		frag0 = "/fragment@0/__overlay__";
		mmc_pins = "/fragment@1/__overlay__/mmc_pins";
	};

	__local_fixups__ {

		fragment@0 {

			__overlay__ {
				pinctrl-0 = <0x0>;
			};
		};

		__overrides__ {
			overclock_50 = <0x0>;
		};
	};

	__fixups__ {
		mmc = "/fragment@0:target:0";
		gpio = "/fragment@1:target:0";
		sdhost = "/fragment@2:target:0";
	};
};
