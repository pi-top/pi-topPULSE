/dts-v1/;

/ {
	compatible = "brcm,bcm2708";

	fragment@0 {
		target-path = [2f 00];

		__overlay__ {

			lirc_rpi {
				compatible = "rpi,lirc-rpi";
				pinctrl-names = "default";
				pinctrl-0 = <0x1>;
				status = "okay";
				rpi,sense = <0xffffffff>;
				rpi,softcarrier = <0x1>;
				rpi,invert = <0x0>;
				rpi,debug = <0x0>;
				phandle = <0x2>;
			};
		};
	};

	fragment@1 {
		target = <0xdeadbeef>;

		__overlay__ {

			lirc_pins {
				brcm,pins = <0x11 0x12>;
				brcm,function = <0x1 0x0>;
				brcm,pull = <0x0 0x1>;
				phandle = <0x1>;
			};
		};
	};

	__overrides__ {
		gpio_out_pin = <0x1 0x6272636d 0x2c70696e 0x733a3000>;
		gpio_in_pin = <0x1 0x6272636d 0x2c70696e 0x733a3400>;
		gpio_in_pull = <0x1 0x6272636d 0x2c70756c 0x6c3a3400>;
		sense = <0x2 0x7270692c 0x73656e73 0x653a3000>;
		softcarrier = [00 00 00 02 72 70 69 2c 73 6f 66 74 63 61 72 72 69 65 72 3a 30 00];
		invert = [00 00 00 02 72 70 69 2c 69 6e 76 65 72 74 3a 30 00];
		debug = <0x2 0x7270692c 0x64656275 0x673a3000>;
	};

	__symbols__ {
		lirc_rpi = "/fragment@0/__overlay__/lirc_rpi";
		lirc_pins = "/fragment@1/__overlay__/lirc_pins";
	};

	__local_fixups__ {

		fragment@0 {

			__overlay__ {

				lirc_rpi {
					pinctrl-0 = <0x0>;
				};
			};
		};

		__overrides__ {
			gpio_out_pin = <0x0>;
			gpio_in_pin = <0x0>;
			gpio_in_pull = <0x0>;
			sense = <0x0>;
			softcarrier = <0x0>;
			invert = <0x0>;
			debug = <0x0>;
		};
	};

	__fixups__ {
		gpio = "/fragment@1:target:0";
	};
};
