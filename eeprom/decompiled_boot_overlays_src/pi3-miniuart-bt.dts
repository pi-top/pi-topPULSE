/dts-v1/;

/ {
	compatible = "brcm,bcm2708";

	fragment@0 {
		target = <0xdeadbeef>;

		__overlay__ {
			pinctrl-names = "default";
			pinctrl-0 = <0xdeadbeef>;
			status = "okay";
		};
	};

	fragment@1 {
		target = <0xdeadbeef>;

		__overlay__ {
			pinctrl-names = "default";
			pinctrl-0 = <0xdeadbeef 0xdeadbeef>;
			status = "okay";
		};
	};

	fragment@2 {
		target = <0xdeadbeef>;

		__overlay__ {
			brcm,pins;
			brcm,function;
			brcm,pull;
		};
	};

	fragment@3 {
		target = <0xdeadbeef>;

		__overlay__ {
			brcm,pins = <0x20 0x21>;
			brcm,function = <0x2>;
			brcm,pull = <0x0 0x2>;
		};
	};

	fragment@4 {
		target-path = "/aliases";

		__overlay__ {
			serial0 = "/soc/serial@7e201000";
			serial1 = "/soc/serial@7e215040";
		};
	};

	__fixups__ {
		uart0 = "/fragment@0:target:0";
		uart0_pins = "/fragment@0/__overlay__:pinctrl-0:0", "/fragment@2:target:0";
		uart1 = "/fragment@1:target:0";
		uart1_pins = "/fragment@1/__overlay__:pinctrl-0:0", "/fragment@3:target:0";
		bt_pins = "/fragment@1/__overlay__:pinctrl-0:4";
	};
};
