/dts-v1/;

/ {
	compatible = "brcm,bcm2708";

	fragment@0 {
		target = <0xdeadbeef>;

		__overlay__ {
			#address-cells = <0x1>;
			#size-cells = <0x0>;
			status = "okay";

			bmp085@77 {
				compatible = "bosch,bmp085";
				reg = <0x77>;
				default-oversampling = <0x3>;
				status = "okay";
			};
		};
	};

	__fixups__ {
		i2c_arm = "/fragment@0:target:0";
	};
};
