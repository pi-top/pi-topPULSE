/dts-v1/;

/ {
	compatible = "brcm,bcm2708";

	fragment@0 {
		target = <0xdeadbeef>;

		__overlay__ {
			#address-cells = <0x1>;
			#size-cells = <0x0>;
			status = "okay";

			pca@40 {
				compatible = "nxp,pca9685";
				#pwm-cells = <0x2>;
				reg = <0x40>;
				status = "okay";
				phandle = <0x1>;
			};
		};
	};

	__overrides__ {
		addr = [00 00 00 01 72 65 67 3a 30 00];
	};

	__symbols__ {
		pca = "/fragment@0/__overlay__/pca@40";
	};

	__local_fixups__ {

		__overrides__ {
			addr = <0x0>;
		};
	};

	__fixups__ {
		i2c_arm = "/fragment@0:target:0";
	};
};
