/dts-v1/;

/ {
	compatible = "brcm,bcm2708";

	fragment@0 {
		target-path = [2f 00];

		__overlay__ {

			ir-receiver {
				compatible = "gpio-ir-receiver";
				gpios = <0xdeadbeef 0x12 0x1>;
				linux,rc-map-name = "rc-rc6-mce";
				status = "okay";
				phandle = <0x1>;
			};
		};
	};

	fragment@1 {
		target = <0xdeadbeef>;

		__overlay__ {

			gpio_ir_pins {
				brcm,pins = <0x12>;
				brcm,function = <0x0>;
				brcm,pull = <0x1>;
				phandle = <0x2>;
			};
		};
	};

	__overrides__ {
		gpio_pin = <0x1 0x6770696f 0x733a3400 0x2 0x6272636d 0x2c70696e 0x733a3000>;
		gpio_pull = <0x2 0x6272636d 0x2c70756c 0x6c3a3000>;
		rc-map-name = [00 00 00 01 6c 69 6e 75 78 2c 72 63 2d 6d 61 70 2d 6e 61 6d 65 00];
	};

	__symbols__ {
		gpio_ir = "/fragment@0/__overlay__/ir-receiver";
		gpio_ir_pins = "/fragment@1/__overlay__/gpio_ir_pins";
	};

	__local_fixups__ {

		__overrides__ {
			gpio_pin = <0x0 0xc>;
			gpio_pull = <0x0>;
			rc-map-name = <0x0>;
		};
	};

	__fixups__ {
		gpio = "/fragment@0/__overlay__/ir-receiver:gpios:0", "/fragment@1:target:0";
	};
};
