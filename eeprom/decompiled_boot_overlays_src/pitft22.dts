/dts-v1/;

/ {
	compatible = "brcm,bcm2835", "brcm,bcm2708", "brcm,bcm2709";

	fragment@0 {
		target = <0xdeadbeef>;

		__overlay__ {
			status = "okay";

			spidev@0 {
				status = "disabled";
			};

			spidev@1 {
				status = "disabled";
			};
		};
	};

	fragment@1 {
		target = <0xdeadbeef>;

		__overlay__ {

			pitft_pins {
				brcm,pins = <0x19>;
				brcm,function = <0x1>;
				brcm,pull = <0x0>;
				phandle = <0x1>;
			};
		};
	};

	fragment@2 {
		target = <0xdeadbeef>;

		__overlay__ {
			#address-cells = <0x1>;
			#size-cells = <0x0>;

			pitft@0 {
				compatible = "ilitek,ili9340";
				reg = <0x0>;
				pinctrl-names = "default";
				pinctrl-0 = <0x1>;
				spi-max-frequency = <0x1e84800>;
				rotate = <0x5a>;
				fps = <0x19>;
				bgr;
				buswidth = <0x8>;
				dc-gpios = <0xdeadbeef 0x19 0x0>;
				debug = <0x0>;
				phandle = <0x2>;
			};
		};
	};

	__overrides__ {
		speed = <0x2 0x7370692d 0x6d61782d 0x66726571 0x75656e63 0x793a3000>;
		rotate = [00 00 00 02 72 6f 74 61 74 65 3a 30 00];
		fps = [00 00 00 02 66 70 73 3a 30 00];
		debug = <0x2 0x64656275 0x673a3000>;
	};

	__symbols__ {
		pitft_pins = "/fragment@1/__overlay__/pitft_pins";
		pitft = "/fragment@2/__overlay__/pitft@0";
	};

	__local_fixups__ {

		fragment@2 {

			__overlay__ {

				pitft@0 {
					pinctrl-0 = <0x0>;
				};
			};
		};

		__overrides__ {
			speed = <0x0>;
			rotate = <0x0>;
			fps = <0x0>;
			debug = <0x0>;
		};
	};

	__fixups__ {
		spi0 = "/fragment@0:target:0", "/fragment@2:target:0";
		gpio = "/fragment@1:target:0", "/fragment@2/__overlay__/pitft@0:dc-gpios:0";
	};
};
