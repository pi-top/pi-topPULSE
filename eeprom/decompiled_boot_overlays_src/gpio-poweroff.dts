/dts-v1/;

/ {
	compatible = "brcm,bcm2708";

	fragment@0 {
		target-path = [2f 00];

		__overlay__ {

			power_ctrl {
				compatible = "gpio-poweroff";
				gpios = <0xdeadbeef 0x1a 0x0>;
				force;
				phandle = <0x1>;
			};
		};
	};

	fragment@1 {
		target = <0xdeadbeef>;

		__overlay__ {

			power_ctrl_pins {
				brcm,pins = <0x1a>;
				brcm,function = <0x1>;
				phandle = <0x2>;
			};
		};
	};

	__overrides__ {
		gpiopin = <0x1 0x6770696f 0x733a3400 0x2 0x6272636d 0x2c70696e 0x733a3000>;
		active_low = <0x1 0x6770696f 0x733a3800>;
	};

	__symbols__ {
		power_ctrl = "/fragment@0/__overlay__/power_ctrl";
		power_ctrl_pins = "/fragment@1/__overlay__/power_ctrl_pins";
	};

	__local_fixups__ {

		__overrides__ {
			gpiopin = <0x0 0xc>;
			active_low = <0x0>;
		};
	};

	__fixups__ {
		gpio = "/fragment@0/__overlay__/power_ctrl:gpios:0", "/fragment@1:target:0";
	};
};
