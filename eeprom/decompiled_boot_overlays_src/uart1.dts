/dts-v1/;

/ {
	compatible = "brcm,bcm2708";

	fragment@0 {
		target = <0xdeadbeef>;

		__overlay__ {
			pinctrl-names = "default";
			pinctrl-0 = <0x1>;
			status = "okay";
		};
	};

	fragment@1 {
		target = <0xdeadbeef>;

		__overlay__ {

			uart1_pins {
				brcm,pins = <0xe 0xf>;
				brcm,function = <0x2>;
				brcm,pull = <0x0 0x2>;
				phandle = <0x1>;
			};
		};
	};

	fragment@2 {
		target-path = "/chosen";

		__overlay__ {
			bootargs = "8250.nr_uarts=1";
		};
	};

	__overrides__ {
		txd1_pin = <0x1 0x6272636d 0x2c70696e 0x733a3000>;
		rxd1_pin = <0x1 0x6272636d 0x2c70696e 0x733a3400>;
	};

	__symbols__ {
		uart1_pins = "/fragment@1/__overlay__/uart1_pins";
	};

	__local_fixups__ {

		fragment@0 {

			__overlay__ {
				pinctrl-0 = <0x0>;
			};
		};

		__overrides__ {
			txd1_pin = <0x0>;
			rxd1_pin = <0x0>;
		};
	};

	__fixups__ {
		uart1 = "/fragment@0:target:0";
		gpio = "/fragment@1:target:0";
	};
};
