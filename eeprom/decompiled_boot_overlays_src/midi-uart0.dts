/dts-v1/;

/ {
	compatible = "brcm,bcm2835";

	fragment@0 {
		target-path = "/clocks";

		__overlay__ {

			midi_clk {
				compatible = "fixed-clock";
				#clock-cells = <0x0>;
				clock-output-names = "uart0_pclk";
				clock-frequency = <0x3840000>;
				phandle = <0x1>;
			};
		};
	};

	fragment@1 {
		target = <0xdeadbeef>;

		__overlay__ {
			clocks = <0x1 0xdeadbeef 0x14>;
		};
	};

	__symbols__ {
		midi_clk = "/fragment@0/__overlay__/midi_clk";
	};

	__local_fixups__ {

		fragment@1 {

			__overlay__ {
				clocks = <0x0>;
			};
		};
	};

	__fixups__ {
		uart0 = "/fragment@1:target:0";
		clocks = "/fragment@1/__overlay__:clocks:4";
	};
};
