/dts-v1/;

/ {
	compatible = "brcm,bcm2835", "brcm,bcm2708", "brcm,bcm2709";

	fragment@0 {
		target = <0xdeadbeef>;

		__overlay__ {
			status = "okay";
		};
	};

	fragment@1 {
		target = <0xdeadbeef>;

		__overlay__ {
			status = "disabled";
		};
	};

	fragment@2 {
		target = <0xdeadbeef>;

		__overlay__ {
			status = "disabled";
		};
	};

	fragment@3 {
		target = <0xdeadbeef>;

		__overlay__ {

			hy28a_pins {
				brcm,pins = <0x11 0x19 0x12>;
				brcm,function = <0x0 0x1 0x1>;
				phandle = <0x1>;
			};
		};
	};

	fragment@4 {
		target = <0xdeadbeef>;

		__overlay__ {
			#address-cells = <0x1>;
			#size-cells = <0x0>;

			hy28a@0 {
				compatible = "ilitek,ili9320";
				reg = <0x0>;
				pinctrl-names = "default";
				pinctrl-0 = <0x1>;
				spi-max-frequency = <0x1e84800>;
				spi-cpol;
				spi-cpha;
				rotate = <0x10e>;
				bgr;
				fps = <0x32>;
				buswidth = <0x8>;
				startbyte = <0x70>;
				reset-gpios = <0xdeadbeef 0x19 0x0>;
				led-gpios = <0xdeadbeef 0x12 0x1>;
				debug = <0x0>;
				phandle = <0x2>;
			};

			hy28a-ts@1 {
				compatible = "ti,ads7846";
				reg = <0x1>;
				spi-max-frequency = <0x1e8480>;
				interrupts = <0x11 0x2>;
				interrupt-parent = <0xdeadbeef>;
				pendown-gpio = <0xdeadbeef 0x11 0x0>;
				ti,x-plate-ohms = [00 64];
				ti,pressure-max = [00 ff];
				phandle = <0x3>;
			};
		};
	};

	__overrides__ {
		speed = <0x2 0x7370692d 0x6d61782d 0x66726571 0x75656e63 0x793a3000>;
		rotate = [00 00 00 02 72 6f 74 61 74 65 3a 30 00];
		fps = [00 00 00 02 66 70 73 3a 30 00];
		debug = <0x2 0x64656275 0x673a3000>;
		xohms = [00 00 00 03 74 69 2c 78 2d 70 6c 61 74 65 2d 6f 68 6d 73 3b 30 00];
		resetgpio = [00 00 00 02 72 65 73 65 74 2d 67 70 69 6f 73 3a 34 00 00 00 00 01 62 72 63 6d 2c 70 69 6e 73 3a 31 00];
		ledgpio = <0x2 0x6c65642d 0x6770696f 0x733a3400 0x1 0x6272636d 0x2c70696e 0x733a3200>;
	};

	__symbols__ {
		hy28a_pins = "/fragment@3/__overlay__/hy28a_pins";
		hy28a = "/fragment@4/__overlay__/hy28a@0";
		hy28a_ts = "/fragment@4/__overlay__/hy28a-ts@1";
	};

	__local_fixups__ {

		fragment@4 {

			__overlay__ {

				hy28a@0 {
					pinctrl-0 = <0x0>;
				};
			};
		};

		__overrides__ {
			speed = <0x0>;
			rotate = <0x0>;
			fps = <0x0>;
			debug = <0x0>;
			xohms = <0x0>;
			resetgpio = <0x0 0x12>;
			ledgpio = <0x0 0x10>;
		};
	};

	__fixups__ {
		spi0 = "/fragment@0:target:0", "/fragment@4:target:0";
		spidev0 = "/fragment@1:target:0";
		spidev1 = "/fragment@2:target:0";
		gpio = "/fragment@3:target:0", "/fragment@4/__overlay__/hy28a@0:reset-gpios:0", "/fragment@4/__overlay__/hy28a@0:led-gpios:0", "/fragment@4/__overlay__/hy28a-ts@1:interrupt-parent:0", "/fragment@4/__overlay__/hy28a-ts@1:pendown-gpio:0";
	};
};
