/dts-v1/;

/ {
	compatible = "brcm,bcm2708";

	fragment@0 {
		target = <0xdeadbeef>;
		#address-cells = <0x1>;
		#size-cells = <0x1>;

		__overlay__ {
			compatible = "brcm,bcm2835-usb";
			reg = <0x7e980000 0x10000>;
			interrupts = <0x1 0x9>;
			dr_mode = "otg";
			g-np-tx-fifo-size = <0x20>;
			g-rx-fifo-size = <0x100>;
			g-tx-fifo-size = <0x200 0x200 0x200 0x200 0x200 0x300>;
			status = "okay";
			phandle = <0x1>;
		};
	};

	__overrides__ {
		dr_mode = <0x1 0x64725f6d 0x6f646500>;
		g-np-tx-fifo-size = <0x1 0x672d6e70 0x2d74782d 0x6669666f 0x2d73697a 0x653a3000>;
		g-rx-fifo-size = [00 00 00 01 67 2d 72 78 2d 66 69 66 6f 2d 73 69 7a 65 3a 30 00];
	};

	__symbols__ {
		dwc2_usb = "/fragment@0/__overlay__";
	};

	__local_fixups__ {

		__overrides__ {
			dr_mode = <0x0>;
			g-np-tx-fifo-size = <0x0>;
			g-rx-fifo-size = <0x0>;
		};
	};

	__fixups__ {
		usb = "/fragment@0:target:0";
	};
};
