/dts-v1/;

/ {
	compatible = "brcm,bcm2708";

	fragment@0 {
		target = <0xdeadbeef>;

		__overlay__ {
			status = "okay";
		};
	};

	fragment@1 {
		target = <0xdeadbeef>;

		__overlay__ {
			#address-cells = <0x1>;
			#size-cells = <0x0>;
			status = "okay";

			pcm5122@4c {
				#sound-dai-cells = <0x0>;
				compatible = "ti,pcm5122";
				reg = <0x4c>;
				AVDD-supply = <0xdeadbeef>;
				DVDD-supply = <0xdeadbeef>;
				CPVDD-supply = <0xdeadbeef>;
				status = "okay";
			};
		};
	};

	fragment@2 {
		target = <0xdeadbeef>;

		__overlay__ {
			compatible = "iqaudio,iqaudio-dac";
			i2s-controller = <0xdeadbeef>;
			status = "okay";
			phandle = <0x1>;
		};
	};

	__overrides__ {
		24db_digital_gain = [00 00 00 01 69 71 61 75 64 69 6f 2c 32 34 64 62 5f 64 69 67 69 74 61 6c 5f 67 61 69 6e 3f 00];
	};

	__symbols__ {
		frag2 = "/fragment@2/__overlay__";
	};

	__local_fixups__ {

		__overrides__ {
			24db_digital_gain = <0x0>;
		};
	};

	__fixups__ {
		i2s = "/fragment@0:target:0", "/fragment@2/__overlay__:i2s-controller:0";
		i2c1 = "/fragment@1:target:0";
		vdd_3v3_reg = "/fragment@1/__overlay__/pcm5122@4c:AVDD-supply:0", "/fragment@1/__overlay__/pcm5122@4c:DVDD-supply:0", "/fragment@1/__overlay__/pcm5122@4c:CPVDD-supply:0";
		sound = "/fragment@2:target:0";
	};
};
