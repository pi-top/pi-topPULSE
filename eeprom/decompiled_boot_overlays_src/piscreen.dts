/dts-v1/;

/ {
	compatible = "brcm,bcm2835", "brcm,bcm2708", "brcm,bcm2709";

	fragment@0 {
		target = <0xdeadbeef>;

		__overlay__ {
			status = "okay";
		};
	};

	fragment@1 {
		target = <0xdeadbeef>;

		__overlay__ {
			status = "disabled";
		};
	};

	fragment@2 {
		target = <0xdeadbeef>;

		__overlay__ {
			status = "disabled";
		};
	};

	fragment@3 {
		target = <0xdeadbeef>;

		__overlay__ {

			piscreen_pins {
				brcm,pins = <0x11 0x19 0x18 0x16>;
				brcm,function = <0x0 0x1 0x1 0x1>;
				phandle = <0x1>;
			};
		};
	};

	fragment@4 {
		target = <0xdeadbeef>;

		__overlay__ {
			#address-cells = <0x1>;
			#size-cells = <0x0>;

			piscreen@0 {
				compatible = "ilitek,ili9486";
				reg = <0x0>;
				pinctrl-names = "default";
				pinctrl-0 = <0x1>;
				spi-max-frequency = <0x16e3600>;
				rotate = <0x10e>;
				bgr;
				fps = <0x1e>;
				buswidth = <0x8>;
				regwidth = <0x10>;
				reset-gpios = <0xdeadbeef 0x19 0x0>;
				dc-gpios = <0xdeadbeef 0x18 0x0>;
				led-gpios = <0xdeadbeef 0x16 0x1>;
				debug = <0x0>;
				init = <0x10000b0 0x0 0x1000011 0x20000ff 0x100003a 0x55 0x1000036 0x28 0x10000c2 0x44 0x10000c5 0x0 0x0 0x0 0x0 0x10000e0 0xf 0x1f 0x1c 0xc 0xf 0x8 0x48 0x98 0x37 0xa 0x13 0x4 0x11 0xd 0x0 0x10000e1 0xf 0x32 0x2e 0xb 0xd 0x5 0x47 0x75 0x37 0x6 0x10 0x3 0x24 0x20 0x0 0x10000e2 0xf 0x32 0x2e 0xb 0xd 0x5 0x47 0x75 0x37 0x6 0x10 0x3 0x24 0x20 0x0 0x1000011 0x1000029>;
				phandle = <0x2>;
			};

			piscreen-ts@1 {
				compatible = "ti,ads7846";
				reg = <0x1>;
				spi-max-frequency = <0x1e8480>;
				interrupts = <0x11 0x2>;
				interrupt-parent = <0xdeadbeef>;
				pendown-gpio = <0xdeadbeef 0x11 0x0>;
				ti,swap-xy;
				ti,x-plate-ohms = [00 64];
				ti,pressure-max = [00 ff];
				phandle = <0x3>;
			};
		};
	};

	__overrides__ {
		speed = <0x2 0x7370692d 0x6d61782d 0x66726571 0x75656e63 0x793a3000>;
		rotate = [00 00 00 02 72 6f 74 61 74 65 3a 30 00];
		fps = [00 00 00 02 66 70 73 3a 30 00];
		debug = <0x2 0x64656275 0x673a3000>;
		xohms = [00 00 00 03 74 69 2c 78 2d 70 6c 61 74 65 2d 6f 68 6d 73 3b 30 00];
	};

	__symbols__ {
		piscreen_pins = "/fragment@3/__overlay__/piscreen_pins";
		piscreen = "/fragment@4/__overlay__/piscreen@0";
		piscreen_ts = "/fragment@4/__overlay__/piscreen-ts@1";
	};

	__local_fixups__ {

		fragment@4 {

			__overlay__ {

				piscreen@0 {
					pinctrl-0 = <0x0>;
				};
			};
		};

		__overrides__ {
			speed = <0x0>;
			rotate = <0x0>;
			fps = <0x0>;
			debug = <0x0>;
			xohms = <0x0>;
		};
	};

	__fixups__ {
		spi0 = "/fragment@0:target:0", "/fragment@4:target:0";
		spidev0 = "/fragment@1:target:0";
		spidev1 = "/fragment@2:target:0";
		gpio = "/fragment@3:target:0", "/fragment@4/__overlay__/piscreen@0:reset-gpios:0", "/fragment@4/__overlay__/piscreen@0:dc-gpios:0", "/fragment@4/__overlay__/piscreen@0:led-gpios:0", "/fragment@4/__overlay__/piscreen-ts@1:interrupt-parent:0", "/fragment@4/__overlay__/piscreen-ts@1:pendown-gpio:0";
	};
};
