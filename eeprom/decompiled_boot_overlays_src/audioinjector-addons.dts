/dts-v1/;

/ {
	compatible = "brcm,bcm2708";

	fragment@0 {
		target = <0xdeadbeef>;

		__overlay__ {
			status = "okay";
		};
	};

	fragment@1 {
		target = <0xdeadbeef>;

		__overlay__ {
			#address-cells = <0x1>;
			#size-cells = <0x0>;
			status = "okay";

			cs42448@48 {
				#sound-dai-cells = <0x0>;
				compatible = "cirrus,cs42448";
				reg = <0x48>;
				clocks = <0x1>;
				clock-names = "mclk";
				VA-supply = <0xdeadbeef>;
				VD-supply = <0xdeadbeef>;
				VLS-supply = <0xdeadbeef>;
				VLC-supply = <0xdeadbeef>;
				status = "okay";
				phandle = <0x2>;
			};

			codec-mclk {
				compatible = "fixed-clock";
				#clock-cells = <0x0>;
				clock-frequency = <0x2ee0000>;
				phandle = <0x1>;
			};
		};
	};

	fragment@2 {
		target = <0xdeadbeef>;

		__overlay__ {
			compatible = "ai,audioinjector-octo-soundcard";
			mult-gpios = <0xdeadbeef 0x1b 0x0 0xdeadbeef 0x16 0x0 0xdeadbeef 0x17 0x0 0xdeadbeef 0x18 0x0>;
			reset-gpios = <0xdeadbeef 0x5 0x0>;
			i2s-controller = <0xdeadbeef>;
			codec = <0x2>;
			status = "okay";
		};
	};

	__symbols__ {
		cs42448 = "/fragment@1/__overlay__/cs42448@48";
		cs42448_mclk = "/fragment@1/__overlay__/codec-mclk";
	};

	__local_fixups__ {

		fragment@1 {

			__overlay__ {

				cs42448@48 {
					clocks = <0x0>;
				};
			};
		};

		fragment@2 {

			__overlay__ {
				codec = <0x0>;
			};
		};
	};

	__fixups__ {
		i2s = "/fragment@0:target:0", "/fragment@2/__overlay__:i2s-controller:0";
		i2c1 = "/fragment@1:target:0";
		vdd_5v0_reg = "/fragment@1/__overlay__/cs42448@48:VA-supply:0";
		vdd_3v3_reg = "/fragment@1/__overlay__/cs42448@48:VD-supply:0", "/fragment@1/__overlay__/cs42448@48:VLS-supply:0", "/fragment@1/__overlay__/cs42448@48:VLC-supply:0";
		sound = "/fragment@2:target:0";
		gpio = "/fragment@2/__overlay__:mult-gpios:0", "/fragment@2/__overlay__:mult-gpios:12", "/fragment@2/__overlay__:mult-gpios:24", "/fragment@2/__overlay__:mult-gpios:36", "/fragment@2/__overlay__:reset-gpios:0";
	};
};
