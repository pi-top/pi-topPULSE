/dts-v1/;

/ {
	compatible = "brcm,bcm2708", "brcm,bcm2709";

	fragment@0 {
		target = <0xdeadbeef>;

		__overlay__ {
			#address-cells = <0x1>;
			#size-cells = <0x0>;
			status = "okay";

			spidev@0 {
				status = "disabled";
			};

			cxd2880@0 {
				compatible = "sony,cxd2880";
				reg = <0x0>;
				spi-max-frequency = <0x2faf080>;
				status = "okay";
			};
		};
	};

	__fixups__ {
		spi0 = "/fragment@0:target:0";
	};
};
