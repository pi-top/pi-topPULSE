/dts-v1/;

/ {
	compatible = "brcm,bcm2708";

	fragment@0 {
		target = <0xdeadbeef>;

		__overlay__ {
			status = "okay";
		};
	};

	fragment@1 {
		target = <0xdeadbeef>;

		__overlay__ {
			#address-cells = <0x1>;
			#size-cells = <0x0>;
			status = "okay";

			wm8731@1a {
				#sound-dai-cells = <0x0>;
				compatible = "wlf,wm8731";
				reg = <0x1a>;
				status = "okay";
			};
		};
	};

	fragment@2 {
		target = <0xdeadbeef>;

		__overlay__ {
			compatible = "rpi,rpi-proto";
			i2s-controller = <0xdeadbeef>;
			status = "okay";
		};
	};

	__fixups__ {
		i2s = "/fragment@0:target:0", "/fragment@2/__overlay__:i2s-controller:0";
		i2c1 = "/fragment@1:target:0";
		sound = "/fragment@2:target:0";
	};
};
