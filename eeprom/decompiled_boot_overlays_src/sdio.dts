/dts-v1/;

/ {
	compatible = "brcm,bcm2708";

	fragment@0 {
		target = <0xdeadbeef>;

		__overlay__ {
			brcm,overclock-50 = <0x0>;
			brcm,pio-limit = <0x1>;
			brcm,debug-flags = <0x0>;
			status = "okay";
			phandle = <0x1>;
		};
	};

	fragment@1 {
		target = <0xdeadbeef>;

		__overlay__ {
			status = "disabled";
		};
	};

	__overrides__ {
		overclock_50 = <0x1 0x6272636d 0x2c6f7665 0x72636c6f 0x636b2d35 0x303a3000>;
		force_pio = <0x1 0x6272636d 0x2c666f72 0x63652d70 0x696f3f00>;
		pio_limit = [00 00 00 01 62 72 63 6d 2c 70 69 6f 2d 6c 69 6d 69 74 3a 30 00];
		debug = <0x1 0x6272636d 0x2c646562 0x75673f00>;
		poll_once = [00 00 00 02 6e 6f 6e 2d 72 65 6d 6f 76 61 62 6c 65 3f 00];
		bus_width = <0x2 0x6275732d 0x77696474 0x683a3000>;
		sdio_overclock = <0x2 0x6272636d 0x2c6f7665 0x72636c6f 0x636b2d35 0x303a3000>;
	};

	fragment@3 {
		target = <0xdeadbeef>;

		__overlay__ {
			pinctrl-names = "default";
			pinctrl-0 = <0x3>;
			non-removable;
			bus-width = <0x4>;
			brcm,overclock-50 = <0x0>;
			status = "okay";
			phandle = <0x2>;
		};
	};

	fragment@4 {
		target = <0xdeadbeef>;

		__overlay__ {

			sdio_pins {
				brcm,pins = <0x16 0x17 0x18 0x19 0x1a 0x1b>;
				brcm,function = <0x7 0x7 0x7 0x7 0x7 0x7>;
				brcm,pull = <0x0 0x2 0x2 0x2 0x2 0x2>;
				phandle = <0x3>;
			};
		};
	};

	__symbols__ {
		frag0 = "/fragment@0/__overlay__";
		sdio_mmc = "/fragment@3/__overlay__";
		sdio_pins = "/fragment@4/__overlay__/sdio_pins";
	};

	__local_fixups__ {

		__overrides__ {
			overclock_50 = <0x0>;
			force_pio = <0x0>;
			pio_limit = <0x0>;
			debug = <0x0>;
			poll_once = <0x0>;
			bus_width = <0x0>;
			sdio_overclock = <0x0>;
		};

		fragment@3 {

			__overlay__ {
				pinctrl-0 = <0x0>;
			};
		};
	};

	__fixups__ {
		sdhost = "/fragment@0:target:0";
		mmc = "/fragment@1:target:0", "/fragment@3:target:0";
		gpio = "/fragment@4:target:0";
	};
};
