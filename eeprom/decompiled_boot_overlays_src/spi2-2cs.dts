/dts-v1/;

/ {
	compatible = "brcm,bcm2835", "brcm,bcm2708", "brcm,bcm2709";

	fragment@0 {
		target = <0xdeadbeef>;

		__overlay__ {

			spi2_pins {
				brcm,pins = <0x28 0x29 0x2a>;
				brcm,function = <0x3>;
				phandle = <0x1>;
			};

			spi2_cs_pins {
				brcm,pins = <0x2b 0x2c>;
				brcm,function = <0x1>;
				phandle = <0x2>;
			};
		};
	};

	fragment@1 {
		target = <0xdeadbeef>;

		__overlay__ {
			#address-cells = <0x1>;
			#size-cells = <0x0>;
			pinctrl-names = "default";
			pinctrl-0 = <0x1 0x2>;
			cs-gpios = <0xdeadbeef 0x2b 0x1 0xdeadbeef 0x2c 0x1>;
			status = "okay";
			phandle = <0x3>;

			spidev@0 {
				compatible = "spidev";
				reg = <0x0>;
				#address-cells = <0x1>;
				#size-cells = <0x0>;
				spi-max-frequency = <0x7a120>;
				status = "okay";
				phandle = <0x4>;
			};

			spidev@1 {
				compatible = "spidev";
				reg = <0x1>;
				#address-cells = <0x1>;
				#size-cells = <0x0>;
				spi-max-frequency = <0x7a120>;
				status = "okay";
				phandle = <0x5>;
			};
		};
	};

	fragment@2 {
		target = <0xdeadbeef>;

		__overlay__ {
			status = "okay";
		};
	};

	__overrides__ {
		cs0_pin = [00 00 00 02 62 72 63 6d 2c 70 69 6e 73 3a 30 00 00 00 00 03 63 73 2d 67 70 69 6f 73 3a 34 00];
		cs1_pin = <0x2 0x6272636d 0x2c70696e 0x733a3400 0x3 0x63732d67 0x70696f73 0x3a313600>;
		cs0_spidev = [00 00 00 04 73 74 61 74 75 73 00];
		cs1_spidev = [00 00 00 05 73 74 61 74 75 73 00];
	};

	__symbols__ {
		spi2_pins = "/fragment@0/__overlay__/spi2_pins";
		spi2_cs_pins = "/fragment@0/__overlay__/spi2_cs_pins";
		frag1 = "/fragment@1/__overlay__";
		spidev2_0 = "/fragment@1/__overlay__/spidev@0";
		spidev2_1 = "/fragment@1/__overlay__/spidev@1";
	};

	__local_fixups__ {

		fragment@1 {

			__overlay__ {
				pinctrl-0 = <0x0 0x4>;
			};
		};

		__overrides__ {
			cs0_pin = <0x0 0x10>;
			cs1_pin = <0x0 0x10>;
			cs0_spidev = <0x0>;
			cs1_spidev = <0x0>;
		};
	};

	__fixups__ {
		gpio = "/fragment@0:target:0", "/fragment@1/__overlay__:cs-gpios:0", "/fragment@1/__overlay__:cs-gpios:12";
		spi2 = "/fragment@1:target:0";
		aux = "/fragment@2:target:0";
	};
};
