/dts-v1/;

/ {
	compatible = "brcm,bcm2835", "brcm,bcm2836", "brcm,bcm2708", "brcm,bcm2709";

	fragment@0 {
		target = <0xdeadbeef>;

		__overlay__ {
			cs-gpios = <0x0 0x0>;
			status = "okay";
		};
	};

	fragment@1 {
		target = <0xdeadbeef>;

		__overlay__ {
			brcm,pins = <0x8 0x7>;
			brcm,function = <0x4>;
		};
	};

	__fixups__ {
		spi0 = "/fragment@0:target:0";
		spi0_cs_pins = "/fragment@1:target:0";
	};
};
