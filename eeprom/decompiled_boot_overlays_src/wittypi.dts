/dts-v1/;

/ {
	compatible = "brcm,bcm2835", "brcm,bcm2708", "brcm,bcm2709";

	fragment@0 {
		target = <0xdeadbeef>;

		__overlay__ {
			compatible = "gpio-leds";

			wittypi_led {
				label = "wittypi_led";
				linux,default-trigger = "default-on";
				gpios = <0xdeadbeef 0x11 0x0>;
				phandle = <0x1>;
			};
		};
	};

	fragment@1 {
		target = <0xdeadbeef>;

		__overlay__ {
			#address-cells = <0x1>;
			#size-cells = <0x0>;

			ds1337@68 {
				compatible = "dallas,ds1337";
				reg = <0x68>;
				wakeup-source;
				phandle = <0x2>;
			};
		};
	};

	__overrides__ {
		led_gpio = <0x1 0x6770696f 0x733a3400>;
		led_trigger = [00 00 00 01 6c 69 6e 75 78 2c 64 65 66 61 75 6c 74 2d 74 72 69 67 67 65 72 00];
	};

	__symbols__ {
		wittypi_led = "/fragment@0/__overlay__/wittypi_led";
		rtc = "/fragment@1/__overlay__/ds1337@68";
	};

	__local_fixups__ {

		__overrides__ {
			led_gpio = <0x0>;
			led_trigger = <0x0>;
		};
	};

	__fixups__ {
		leds = "/fragment@0:target:0";
		gpio = "/fragment@0/__overlay__/wittypi_led:gpios:0";
		i2c1 = "/fragment@1:target:0";
	};
};
